## components/epm_drivers/Kconfig
```kconfig
menu "EPM Drivers"

    config EPM_ACCEL_USE_STUB
        bool "Use synthetic accelerometer stub (no KX134 hardware)"
        default n
        help
            Selects components/epm_drivers/accel_stub.c as the hal_accel.h
            implementation instead of the real accel_kx134_spi.c driver.
            The real driver is hardware-confirmed (WHO_AM_I, at-rest
            g-values, zero dropped FIFO frames over a sustained run --
            docs/decisions/ADR-017) and validated running concurrently
            with real MQTT publishing with zero crashes (ADR-024). Default
            is now n; set y for development/CI without KX134 hardware
            wired up.

    config EPM_DISPLAY_USE_LEDC
        bool "Use plain-LEDC RGB LED (no WS2812/NeoPixel hardware)"
        default n
        help
            Selects components/epm_drivers/display_ledc.c as the hal_display.h
            implementation instead of the default WS2812 NeoPixel driver
            (display_neopixel.c). Kept as a Kconfig fallback for boards
            without an addressable RGB LED wired up -- see
            docs/decisions/ADR-016.

    config EPM_STATUS_LED_SELFTEST
        bool "TEMPORARY/TEST-ONLY: fire a manufactured STATUS_LED at boot"
        default n
        help
            Phase 7c hardware-validation aid, not for normal builds. Makes
            src/threads/net_task.c invoke its own just-registered cmd
            handler once at boot with a manufactured STATUS_LED payload,
            so the decode-dispatch-LED-update path can be confirmed on
            real hardware without a working MQTT broker connection
            (ADR-011's known TCP-handshake stall against the only
            reachable stand-in broker blocks real command delivery).
            Leave n for normal builds -- see docs/decisions/ADR-025.

    config EPM_MQTT_RECONNECT_STRESS_TEST
        bool "TEMPORARY/TEST-ONLY: repeatedly call link_mqtt_start() at boot"
        default n
        help
            Accelerated leak-per-call test for link_mqtt_start()'s
            retry-path fix (commit dab1064: destroying the stale s_client
            handle before re-init). Normal operation only calls
            link_mqtt_start() once at boot -- net_task.c's own retry loop
            only repeats if that first call fails outright, and every
            mid-session drop afterward is handled entirely inside
            esp-mqtt's own internal reconnect state machine, which never
            calls link_mqtt_start() again. That means ordinary running
            time, however long, can't exercise this function's leak-fix
            path more than once per boot. This makes
            src/threads/net_task.c call it 50 times back to back 30s after
            boot, logging free internal heap before/after each call, so a
            per-call leak - if any - shows up as a monotonic decline.
            Leave n for normal builds.

endmenu
```
